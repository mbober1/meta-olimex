## conf/layer.conf
```bitbake
# We have a conf and classes directory, add to BBPATH
BBPATH .= ":${LAYERDIR}"

# We have recipes-* directories, add to BBFILES
BBFILES += "${LAYERDIR}/recipes-*/*/*.bb \
            ${LAYERDIR}/recipes-*/*/*.bbappend"

BBFILE_COLLECTIONS += "meta-olimex"
BBFILE_PATTERN_meta-olimex = "^${LAYERDIR}/"
BBFILE_PRIORITY_meta-olimex = "6"

LAYERDEPENDS_meta-olimex = "core"
LAYERSERIES_COMPAT_meta-olimex = "scarthgap"
```
